## conf/layer.conf
```bitbake
# We have a conf and classes directory, add to BBPATH
BBPATH .= ":${LAYERDIR}"

# We have recipes-* directories, add to BBFILES
BBFILES += "${LAYERDIR}/recipes-*/*/*.bbappend \
            ${LAYERDIR}/recipes-*/*/*.bb"

BBFILE_COLLECTIONS += "elbe-ext"
BBFILE_PATTERN_elbe-ext = "^${LAYERDIR}/"
BBFILE_PRIORITY_elbe-ext = "6"
```
